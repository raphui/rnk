## Kconfig
```kconfig
mainmenu "rnk kernel configuration"

config ARCH
    string
    option env="ARCH"

if !DYNAMIC_APPS
source apps/Kconfig
endif

source "arch/$ARCH/Kconfig"
source boards/Kconfig
source kernel/Kconfig
source ldscripts/Kconfig
source lib/Kconfig
source loader/Kconfig
source drivers/Kconfig
source mm/Kconfig
source pm/Kconfig
source third_party/Kconfig
source utils/Kconfig
```

## apps/Kconfig
```kconfig
choice
    prompt "Application"
    config SENSOR_APP
        bool "Sensor BME280 application"

    config TEST_MTD
	bool "MTD test"	

    config TEST_MUTEX
	bool "Mutex test"	

    config TEST_QUEUE
	bool "Queue test"	

    config TEST_SEM
	bool "Semaphore test"	

    config TEST_SYSCALL
	bool "Syscall test"	

    config TEST_THREAD
	bool "Thread test"	

    config TEST_TIMER
	bool "Timer test"	

    config TEST_TICKLESS
	bool "Tickless test"
endchoice
```

## arch/arm/Kconfig
```kconfig
# Copyright (C) 2015 Raphaël Poggi. All rights reserved.
# Author: Raphaël Poggi <poggi.raph@gmail.com>
#
# Provided under the three clause BSD license found in the LICENSE file.

menu "Architecture configuration"

config CPU_ARM
    bool

config CPU_ARMV7
    bool
    select CPU_ARM

config CPU_ARM_THUMB
    bool

choice
   prompt "Architecture"

config CPU_ARMV7A
    bool "ARMV7A"
    select CPU_ARMV7

config CPU_ARMV7M
    bool "ARM7M"
    select CPU_ARMV7
    select CPU_ARM_THUMB

endchoice

choice
   prompt "CPU"

config CPU_ARM_CORTEX_M3
    bool "Cortex-M3"
    depends on CPU_ARMV7M

config CPU_ARM_CORTEX_M4
    bool "Cortex-M4"
    depends on CPU_ARMV7M

config CPU_ARM_CORTEX_M7
    bool "Cortex-M7"
    depends on CPU_ARMV7M

config CPU_ARM_CORTEX_A5
    bool "Cortex-A5"
    depends on CPU_ARMV7A

endchoice

choice
    prompt "Endianess"
    default LITTLE_ENDIAN

config BIG_ENDIAN
    bool "Big Endian"

config LITTLE_ENDIAN
    bool "Little Endian"

endchoice

endmenu
```

## arch/arm/armv8a/Kconfig
```kconfig
# Copyright (C) 2016 Raphaël Poggi. All rights reserved.
# Author: Raphaël Poggi <poggi.raph@gmail.com>
#
# Provided under the three clause BSD license found in the LICENSE file.

menu "Architecture configuration"

config CPU_ARM64
    bool
    default y

config CPU_ARMV8
    bool
    select CPU_ARM

choice
   prompt "Architecture"

config CPU_ARM_CORTEX_A53
    bool "Cortex-A53"
    select CPU_ARMV8

config CPU_ARM_CORTEX_A57
    bool "Cortex-A57"
    select CPU_ARMV8

endchoice

choice
    prompt "Endianess"
    default LITTLE_ENDIAN

config BIG_ENDIAN
    bool "Big Endian"

config LITTLE_ENDIAN
    bool "Little Endian"

endchoice

endmenu
```

## arch/arm/lib/Kconfig
```kconfig
menu "ARM library configuration"

config SEMIHOSTING
    bool "Enable semihosting features"

endmenu
```

## boards/Kconfig
```kconfig
menu "Board configuration"

choice
    prompt "Machine"

    config MACH_STM32
        bool "STM32"
endchoice

if MACH_STM32
source "boards/mach-stm32/Kconfig"
endif


endmenu
```

## boards/mach-qemu/Kconfig
```kconfig
# Copyright (C) 2016 Raphaël Poggi. All rights reserved.
# Author: Raphaël Poggi <poggi.raph@gmail.com>
#
# Provided under the three clause BSD license found in the LICENSE file.

menu "QEMU configuration"

choice
    prompt "SoC"

    config QEMU_VIRT
        bool "QEMU virt"
	select MACH_HAVE_GENERIC_TIMER

endchoice

config TEXT_BASE
	hex "Kernel location in memory"

endmenu
```

## boards/mach-stm32/Kconfig
```kconfig
config STM32F4XX
	bool

config STM32F7XX
	bool

config STM32L4XX
	bool

menu "STM32 configuration"

choice
    prompt "SoC"

    config STM32F401
        bool "STM32F401"
	select STM32F4XX

    config STM32F407
        bool "STM32F407"
	select STM32F4XX

    config STM32F429
        bool "STM32F429"
	select STM32F4XX

    config STM32F746
        bool "STM32F746"
	select STM32F7XX

    config STM32L443
        bool "STM32L443"
	select STM32L4XX

endchoice

config NUM_IRQS
	int "Number of IRQS"

config GPIO_PER_PORT
	int "Number of gpio per port"

config GPIO_PORT_NUM
	int "Number of gpio port"

config EXTI_LINES
	int "Number of EXTI Lines"
	default 40

config DMA_REQUEST_LINES
	int "Number of DMA request lines"
	default 8

endmenu
```

## drivers/Kconfig
```kconfig
menu "Drivers configuration"

config IRQ_SUBSYS
	bool "IRQ subsystem driver"

config LCD_SUBSYS
	bool "LCD subsystem driver"

config I2C_SUBSYS
	bool "I2C subsystem driver"

config SPI_SUBSYS
	bool "SPI subsystem driver"

config AT45DB
	depends on SPI_SUBSYS
	bool "NOR flash driver for AT45DB"

config BME280
	depends on SPI_SUBSYS
	bool "BME280 humidity driver"

config SPIDEV
	depends on SPI_SUBSYS
	bool "SPIDEV driver"

config USARTDEV
	bool "USARTDEV driver"

config ILI9341
	depends on SPI_SUBSYS && LCD_SUBSYS
	bool "TFT driver for ILI9341"

config ILI9341_FRAME_BUFFER
	depends on ILI9341
	hex "Address of the frame buffer"

config TIMER_SUBSYS
	bool "Timer subsystem driver"

config USB_SUBSYS
	bool "USB subsystem driver"

endmenu
```

## kernel/Kconfig
```kconfig
menu "Kernel configuration"

config STATIC_APPS
	default y
	bool "User application statically linked with kernel"

config USER
	depends on !STATIC_APPS
	bool "Usermode allows isolation between kernel and user loaded application"

config MAX_THREADS
	depends on !MALLOC
	int "Max number of threads"

config THREAD_STACK_START
	hex "Start address of kernel THREAD stack"

config THREAD_STACK_SIZE
	hex "Size of kernel THREAD stack"

choice
    prompt "Scheduling algorithms"

    config SCHEDULE_RR_PRIO
        bool "Round Robin Priority scheduling algorithm"

    config SCHEDULE_ROUND_ROBIN
        bool "Round Robin scheduling algorithm"

    config SCHEDULE_PRIORITY
        bool "Priority scheduling algorithm"
endchoice

config THREAD_QUANTUM
	depends on SCHEDULE_ROUND_ROBIN || SCHEDULE_RR_PRIO
	int "THREAD quantum"

config HR_TIMER
	bool "High resolution timer using hardware IP"

config BW_DELAY
	depends on !HR_TIMER
	bool "Delay functions are implement as busy-wait"

config TICKLESS
	bool "Tickless kernel"

config SEMAPHORE
	bool "Enable semaphore primitive"

config MUTEX
	bool "Enable mutex primitive"

config QUEUE
	depends on MALLOC
	bool "Enable queue primitive"

config PRIORITY_INHERITANCE
	depends on MUTEX
	bool "Enable priority inheritance for mutex"

endmenu
```

## ldscripts/Kconfig
```kconfig
menu "Memory map configuration"

config TEXT_BASE
	hex "Address for rnk text"

config TEXT_SIZE
	hex "Maximum text size"

config RAM_BASE
	hex "Address for rnk data and bss"

config RAM_SIZE
	hex "Maximum rnk ram size"

endmenu
```

## loader/Kconfig
```kconfig
menu "Loader configuration"

choice
    depends on !STATIC_APPS
    prompt "Application loader"

    config ELF_LOADER
        bool "Use ELF loader"

    config RFLAT_LOADER
        bool "Use RFLAT loader"
endchoice

endmenu
```

## mm/Kconfig
```kconfig
menu "Memory management configuration"

config MALLOC
	bool "Enable use of malloc"

config KERNEL_HEAP_START
	depends on MALLOC
	hex "Start address of kernel heap"

config KERNEL_HEAP_END
	depends on MALLOC
	hex "End address of kernel heap"

config USER_HEAP_START
	depends on MALLOC
	hex "Start address of user heap"

config USER_HEAP_END
	depends on MALLOC
	hex "End address of user heap"

choice
	depends on MALLOC
	prompt "malloc implementation"

config CUSTOM_MALLOC
	bool "Use custom malloc implementation"

config TLSF
	bool "Use tlsf implementation"

endchoice

endmenu
```

## pm/Kconfig
```kconfig
menu "Power management configuration"

config PM
	bool "Enable power management"

endmenu
```

## third_party/Kconfig
```kconfig
menu "Third party configuration"

source "third_party/lib/Kconfig"

config USB_STACK
	depends on (STM32F4XX || STM32L4XX) && USB_SUBSYS
	bool "Enable use of usb stack"

endmenu
```

## third_party/lib/Kconfig
```kconfig
menu "Third party library configuration"

config LIBFDT
	bool "Enable use of libfdt"

endmenu
```

## utils/Kconfig
```kconfig
menu "Utility configuration"

config UNWIND
	bool "Enable stack unwinding"

choice
    prompt "Debug output"
    default LITTLE_ENDIAN

config USART_DEBUG
    bool "USART"

config SWO_DEBUG
    bool "SWO"

config SEMIHOSTING_DEBUG
    depends on SEMIHOSTING
    bool "Semihosting"

config SEMIHOSTING_DEBUG_BUFFERED
    depends on SEMIHOSTING_DEBUG
    bool "Buffered output (faster)"


endchoice

menu "Debug level"

config DEBUG
    bool "Print debug logs"

config ERROR
    bool "Print error logs"

config VERBOSE
    bool "Print verbose logs"

endmenu

endmenu
```
